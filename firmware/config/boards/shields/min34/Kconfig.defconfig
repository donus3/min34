## firmware/config/boards/shields/min34/Kconfig.defconfig
```kconfig
if SHIELD_MIN34_LEFT

config ZMK_KEYBOARD_NAME
    default "min34 split keyboard"

config ZMK_SPLIT_ROLE_CENTRAL
    default y

endif

if SHIELD_MIN34_LEFT || SHIELD_MIN34_RIGHT

config ZMK_SPLIT
    default y

endif
```

## firmware/config/boards/shields/min34/Kconfig.shield
```kconfig
config SHIELD_MIN34_LEFT
    def_bool $(shields_list_contains,min34_left)

config SHIELD_MIN34_RIGHT
    def_bool $(shields_list_contains,min34_right)
```

## firmware/config/west.yml
```yaml
manifest:
  remotes:
    - name: min34
      url-base: https://github.com/donus3/min34
    - name: zmkfirmware
      url-base: https://github.com/zmkfirmware
  projects:
    - name: zmk
      remote: zmkfirmware
      revision: main
      import: app/west.yml
  self:
    path: config
```
